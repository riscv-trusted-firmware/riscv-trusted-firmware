## Kconfig
```kconfig
# SPDX-License-Identifier: BSD-3-Clause
# Copyright (c) 2026, The RISC-V Trusted Firmware contributors

#
# Top-level Kconfig. Order matters: platforms are sourced first so that a
# platform can provide defaults for symbols owned by drivers, services, etc.
# (a 'default' listed first wins).

mainmenu "$(PROJECT_NAME) $(PROJECT_VERSION) configuration"

source "platform/Kconfig"
source "arch/Kconfig"

menu "General"

choice
	prompt "Optimisation level"
	default OPTIMIZE_SIZE

config OPTIMIZE_SIZE
	bool "Size (-Os)"

config OPTIMIZE_SPEED
	bool "Speed (-O2)"

config OPTIMIZE_DEBUG
	bool "Debug (-Og)"

endchoice

config DEBUG_INFO
	bool "Compile with debug info (-g3)"
	default y

config WERROR
	bool "Treat warnings as errors"
	default y

config STACK_PROTECTOR
	bool "Stack canaries (-fstack-protector-strong)"
	default y
	help
	  A function with an array or an address taken of a local checks a
	  canary before it returns, and the monitor panics when it is gone:
	  an overflow of a buffer on the stack stops the machine instead of
	  choosing the return address. The canary is a constant with a zero
	  byte in it, the same in every build: it stops the overflow that
	  runs on from a buffer, not the write that knows where it goes.

config STACK_USAGE
	bool "Emit per-function stack usage (.su files)"

config STACK_SIZE
	hex "Per-hart stack size"
	default 0x2000

config LOG_LEVEL
	int "Log level (0=none, 1=error, 2=warn, 3=info, 4=debug)"
	range 0 4
	default 3

config BOOT_HANDOVER
	bool "Take a hand-over block from the previous stage (a2)"
	default y
	help
	  The previous boot stage may pass, in a2, a block that says where the
	  next stage after this one is, in which mode it starts and which hart
	  is to boot: what U-Boot SPL, EDK2, coreboot and QEMU (-kernel) hand
	  to the M-mode firmware they start. See include/handover.h. Without
	  a block the configured addresses apply. Say n when a2 is not to be
	  looked at.

endmenu

source "images/Kconfig"
source "lib/Kconfig"
source "drivers/Kconfig"
source "services/Kconfig"
```

## arch/Kconfig
```kconfig
# SPDX-License-Identifier: BSD-3-Clause
# Copyright (c) 2026, The RISC-V Trusted Firmware contributors

menu "Architecture"

source "arch/riscv/Kconfig"

endmenu
```

## arch/riscv/Kconfig
```kconfig
# SPDX-License-Identifier: BSD-3-Clause
# Copyright (c) 2026, The RISC-V Trusted Firmware contributors

#
# RISC-V ISA configuration.
#
#  RISCV_ISA_*  extensions the compiler may use (they form -march)
#  RISCV_EXT_*  privileged / runtime extensions the firmware drives
#               (no compiler impact; only ratified specifications)
#
# A platform normally 'select's what its SoC implements from
# platform/<vendor>/<board>/Kconfig.

choice
	prompt "Base ISA"
	default RISCV_RV64I

config RISCV_RV64I
	bool "RV64I"

config RISCV_RV32I
	bool "RV32I"

endchoice

config 64BIT
	bool
	default RISCV_RV64I

config RISCV_XLEN
	int
	default 64 if RISCV_RV64I
	default 32

menu "Compiler ISA extensions (-march)"

config RISCV_ISA_M
	bool "M: integer multiply/divide"
	default y

config RISCV_ISA_A
	bool "A: atomics"
	default y
	help
	  Required for SMP boot (boot-hart lottery, spinlocks).

config RISCV_ISA_F
	bool "F: single-precision floating point"

config RISCV_ISA_D
	bool "D: double-precision floating point"
	depends on RISCV_ISA_F

config RISCV_ISA_C
	bool "C: compressed instructions"
	default y

config RISCV_ISA_ZICSR
	bool
	default y

config RISCV_ISA_ZIFENCEI
	bool
	default y

config RISCV_ISA_ZICBOM
	bool "Zicbom: cache-block management"

config RISCV_ISA_ZICBOZ
	bool "Zicboz: cache-block zero"

config RISCV_ISA_ZIHINTPAUSE
	bool "Zihintpause: PAUSE hint"

config RISCV_ISA_ZBA
	bool "Zba: address generation"

config RISCV_ISA_ZBB
	bool "Zbb: basic bit manipulation"

config RISCV_ISA_ZBC
	bool "Zbc: carry-less multiply"

config RISCV_ISA_ZBS
	bool "Zbs: single-bit operations"

config RISCV_ISA_EXTRA
	string "Extra -march suffix"
	default ""
	help
	  Appended verbatim to the generated -march string, e.g. "_zkr_zkt".

config RISCV_HARD_FLOAT_ABI
	bool "Use a hard-float calling convention inside the firmware"
	depends on RISCV_ISA_F
	help
	  Off by default: the firmware itself never touches FP registers,
	  so it does not have to save/restore them around traps.

config RISCV_ABI
	string
	default "lp64d" if 64BIT && RISCV_HARD_FLOAT_ABI && RISCV_ISA_D
	default "lp64f" if 64BIT && RISCV_HARD_FLOAT_ABI
	default "lp64" if 64BIT
	default "ilp32d" if RISCV_HARD_FLOAT_ABI && RISCV_ISA_D
	default "ilp32f" if RISCV_HARD_FLOAT_ABI
	default "ilp32"

config RISCV_STRICT_ALIGN
	bool "Never emit misaligned accesses (-mstrict-align)"

config RISCV_NO_RELAX
	bool "Disable linker relaxation"

endmenu

menu "Privileged and runtime extensions"

config RISCV_EXT_SMEPMP
	bool "Smepmp: PMP enhancements for memory access and execution prevention"

config RISCV_EXT_SSTC
	bool "Sstc: supervisor timer compare (stimecmp)"

config RISCV_EXT_SMSTATEEN
	bool "Smstateen: state enable"

config RISCV_EXT_SMAIA
	bool "Smaia/Ssaia: advanced interrupt architecture CSRs"

config RISCV_EXT_SSCOFPMF
	bool "Sscofpmf: count overflow and mode-based filtering"

config RISCV_EXT_SVPBMT
	bool "Svpbmt: page-based memory types"

config RISCV_PMP_COUNT
	int "Number of implemented PMP entries"
	range 0 64
	default 16

endmenu
```

## configs/qemu_virt_rv64_2stage_defconfig
```kconfig
CONFIG_PLAT_QEMU_VIRT=y
CONFIG_RISCV_RV64I=y
CONFIG_RISCV_EXT_SMEPMP=y
CONFIG_IMAGE_LOADER=y
CONFIG_IMAGE_SBITEST=y
```

## drivers/core/Kconfig
```kconfig
# SPDX-License-Identifier: BSD-3-Clause
# Copyright (c) 2026, The RISC-V Trusted Firmware contributors

config DRIVER_CORE
	bool
	default y
	help
	  Driver table and console multiplexer (always built).
```

## drivers/cppc/Kconfig
```kconfig
# SPDX-License-Identifier: BSD-3-Clause
# Copyright (c) 2026, The RISC-V Trusted Firmware contributors

menu "CPPC"

config CPPC
	bool

config CPPC_RPMI
	bool "RPMI CPPC service group"
	depends on RPMI
	select CPPC
	help
	  Collaborative processor performance control registers served by
	  the platform microcontroller, for the SBI CPPC extension.

config CPPC_RPMI_FEEDBACK_AS_DELIVERED_CTR
	bool "Read DeliveredPerformanceCounter from the feedback fast channel"
	depends on CPPC_RPMI
	help
	  The performance feedback fast channel of RPMI holds the hart's
	  current frequency in Hz, which no SBI CPPC register is. Other
	  firmware returns it as DeliveredPerformanceCounter; say y for
	  a platform whose S-mode software counts on that. Otherwise that
	  register is read from the PuC by message like the others, and the
	  feedback channel is not used.

endmenu
```

## drivers/gpio/Kconfig
```kconfig
# SPDX-License-Identifier: BSD-3-Clause
# Copyright (c) 2026, The RISC-V Trusted Firmware contributors

menu "GPIO"

config GPIO
	bool
	help
	  Output lines for the monitor's drivers: a board that is reset or
	  powered off by a GPIO.

config GPIO_SIFIVE
	bool "SiFive GPIO"
	select GPIO

endmenu
```

## drivers/hsm/Kconfig
```kconfig
# SPDX-License-Identifier: BSD-3-Clause
# Copyright (c) 2026, The RISC-V Trusted Firmware contributors

menu "Hart power"

config HSM_RPMI
	bool "RPMI HSM service group"
	depends on RPMI
	help
	  Tell the platform microcontroller when harts are started, stopped
	  and suspended (SBI HSM), so that it can power them up and down. Its
	  suspend types are the platform specific ones of sbi_hart_suspend().

config HSM_RPMI_MAX_SUSPEND_TYPES
	int "Most suspend types of a PuC"
	depends on HSM_RPMI
	default 8

endmenu
```

## drivers/ipi/Kconfig
```kconfig
# SPDX-License-Identifier: BSD-3-Clause
# Copyright (c) 2026, The RISC-V Trusted Firmware contributors

menu "Inter-processor interrupts"

config IPI_ACLINT_MSWI
	bool "RISC-V ACLINT MSWI / SiFive CLINT software interrupts"
	help
	  Found in the device tree ("riscv,aclint-mswi", "riscv,clint0",
	  "sifive,clint0"). The address below applies when no node matches.

if IPI_ACLINT_MSWI

config IPI_ACLINT_MSWI_ADDR
	hex "MSIP register array address"
	default 0x0

config IPI_ACLINT_MSWI_SIZE
	hex "Size of the MSWI register block"
	default 0x4000
	help
	  Kept from S/U-mode. The SiFive CLINT has its timer right behind.

config IPI_ACLINT_MSWI_FIRST_HART
	int "Hart id of the first MSIP register"
	default 0

endif

config IPI_ANDES_PLICSW
	bool "Andes PLICSW software interrupts"

endmenu
```

## drivers/irqchip/Kconfig
```kconfig
# SPDX-License-Identifier: BSD-3-Clause
# Copyright (c) 2026, The RISC-V Trusted Firmware contributors

menu "Interrupt controllers"

config IRQCHIP
	bool
	select LIBFDT
	help
	  External interrupt controllers are found in the device tree: the
	  monitor quiets their machine-level parts, delegates the interrupt
	  sources to S-mode and hides what is machine-level from the next
	  stage's device tree.

config IRQCHIP_PLIC
	bool "RISC-V PLIC"
	select IRQCHIP

config IRQCHIP_APLIC
	bool "RISC-V APLIC (AIA wired interrupts)"
	select IRQCHIP

config IRQCHIP_IMSIC
	bool "RISC-V IMSIC (AIA message-signalled interrupts)"
	select IRQCHIP

config IRQCHIP_IMSIC_PROTECT
	bool "Hide the machine-level interrupt files from S/U-mode"
	depends on IRQCHIP_IMSIC
	default y
	help
	  They are where the monitor's IPIs and MSIs arrive: nothing S-mode
	  should be able to write to. Say n only where what sends the monitor
	  an MSI is S-mode software itself, a model of a device for testing.

endmenu
```

## drivers/reset/Kconfig
```kconfig
# SPDX-License-Identifier: BSD-3-Clause
# Copyright (c) 2026, The RISC-V Trusted Firmware contributors

menu "System reset"

config RESET_SIFIVE_TEST
	bool "SiFive test finisher (QEMU virt / sifive_u power-off and reboot)"

config RESET_SIFIVE_TEST_ADDR
	hex "Register address when the device tree has no node for it"
	default 0x0
	depends on RESET_SIFIVE_TEST

config RESET_SYSCON
	bool "Generic syscon-poweroff / syscon-reboot"
	help
	  A value written to a system controller register, as the device
	  tree describes it.

config RESET_HTIF
	bool "HTIF (leaving a simulation)"
	select SERIAL_HTIF

config RESET_GPIO
	bool "gpio-poweroff / gpio-restart"
	depends on GPIO

config RESET_WDT
	bool "Watchdog reset (Allwinner D1, Andes ATCWDT200)"

config RESET_RPMI
	bool "RPMI SYSTEM_RESET service group"
	depends on RPMI
	help
	  Shutdown and reboot through the platform microcontroller. Preferred
	  over the other reset devices for the reset types the PuC supports.

endmenu
```

## drivers/rpmi/Kconfig
```kconfig
# SPDX-License-Identifier: BSD-3-Clause
# Copyright (c) 2026, The RISC-V Trusted Firmware contributors

menu "RPMI (RISC-V Platform Management Interface)"

config RPMI
	bool "RPMI client"
	help
	  Talk to a platform microcontroller: the message protocol, the
	  request / acknowledgment engine and the notification path. Needs a
	  transport below.

if RPMI

config RPMI_MAX_DATA_LEN
	int "Largest message data the client handles (bytes)"
	default 248
	help
	  An upper bound for the transport's own limit (slot size minus the
	  8-byte header); sizes the client's bounce buffer. A multiple of 4.

config RPMI_TIMEOUT_US
	int "Send and acknowledgment timeout (microseconds)"
	default 100000

config RPMI_SHMEM
	bool "Shared memory transport"

if RPMI_SHMEM

config RPMI_SHMEM_MAX_INSTANCES
	int "Most shared memory transports the monitor drives"
	default 2
	help
	  The transports are "riscv,rpmi-shmem-mbox" nodes of the device
	  tree: queue addresses, slot size and doorbell come from there.

config RPMI_SHMEM_PROTECT
	bool "Hide the shared memory from S/U-mode"
	default y
	help
	  The queues and the doorbell become machine-only memory regions.
	  S-mode then reaches the PuC through MPXY only. Shared memory that
	  lies in RAM is added to /reserved-memory of the next stage either
	  way.

endif

endif

endmenu
```

## drivers/serial/Kconfig
```kconfig
# SPDX-License-Identifier: BSD-3-Clause
# Copyright (c) 2026, The RISC-V Trusted Firmware contributors

menu "Serial"

# The console is the UART /chosen/stdout-path of the device tree names, or
# the first one in the tree a driver below knows.

config SERIAL_UART8250
	bool "8250/16550-compatible UART"
	help
	  ns16550a, the DesignWare APB UART and the like. The values below
	  apply when there is no tree to take them from; a base address of 0
	  means there is no such default.

if SERIAL_UART8250

config SERIAL_UART8250_BASE
	hex "Register base address"
	default 0x0

config SERIAL_UART8250_CLOCK
	int "Input clock (Hz)"
	default 0

config SERIAL_UART8250_BAUD
	int "Baud rate"
	default 115200

config SERIAL_UART8250_REG_SHIFT
	int "Register stride shift"
	default 0

config SERIAL_UART8250_REG_WIDTH
	int "Register access width (bytes)"
	default 1

endif

config SERIAL_SIFIVE
	bool "SiFive UART"

config SERIAL_HTIF
	bool "HTIF console (Spike and relatives)"

config SERIAL_HTIF_BASE
	hex "Address of fromhost when the device tree does not say"
	depends on SERIAL_HTIF
	default 0x1000000
	help
	  A simulator looks the words up by symbol in an ELF; given a raw
	  binary it falls back to an address of its own, QEMU's spike
	  machine to this one. tohost follows 8 bytes later.

config SERIAL_UARTLITE
	bool "Xilinx UART Lite"

config SERIAL_CADENCE
	bool "Cadence UART"

config SERIAL_LITEX
	bool "LiteX UART"

config SERIAL_GAISLER
	bool "Gaisler APBUART"

config SERIAL_SHAKTI
	bool "Shakti UART"

config SERIAL_RENESAS_SCIF
	bool "Renesas SCIF (RZ/Five)"

config SERIAL_SEMIHOSTING
	bool "Semihosting output, when there is no UART"
	help
	  Characters go to a debugger or simulator that implements the
	  semihosting calls. Only used when nothing else gave a console and a
	  host answers.

endmenu
```

## drivers/suspend/Kconfig
```kconfig
# SPDX-License-Identifier: BSD-3-Clause
# Copyright (c) 2026, The RISC-V Trusted Firmware contributors

menu "System suspend"

config SUSPEND_RPMI
	bool "RPMI SYSTEM_SUSPEND service group"
	depends on RPMI
	help
	  Tell the platform microcontroller when S-mode suspends the system
	  (SBI SUSP), so that it can take the platform down once the last
	  hart waits for an interrupt.

endmenu
```

## drivers/timer/Kconfig
```kconfig
# SPDX-License-Identifier: BSD-3-Clause
# Copyright (c) 2026, The RISC-V Trusted Firmware contributors

menu "Timer"

config TIMER_ACLINT_MTIMER
	bool "RISC-V ACLINT MTIMER / SiFive CLINT timer"
	help
	  Found in the device tree ("riscv,aclint-mtimer", "riscv,clint0",
	  "sifive,clint0"). The addresses below apply when no node matches.

if TIMER_ACLINT_MTIMER

config TIMER_ACLINT_MTIMER_MTIME_ADDR
	hex "MTIME register address"
	default 0x0

config TIMER_ACLINT_MTIMER_MTIMECMP_ADDR
	hex "MTIMECMP register array address"
	default 0x0

config TIMER_ACLINT_MTIMER_FIRST_HART
	int "Hart id of the first MTIMECMP register"
	default 0

endif

endmenu
```

## images/loader/Kconfig
```kconfig
# SPDX-License-Identifier: BSD-3-Clause
# Copyright (c) 2026, The RISC-V Trusted Firmware contributors

config IMAGE_LOADER
	bool "First-stage loader"
	help
	  Minimal first stage: runs from the reset/firmware address and hands
	  over to the monitor at LOADER_NEXT_STAGE_ADDR, preserving the hart
	  id and device tree. Exercises the multi-image build; image loading
	  and verification come later.

if IMAGE_LOADER

config LOADER_LOAD_ADDR
	hex "Loader link/load address"
	default PLATFORM_FW_START

config LOADER_SIZE
	hex "Memory reserved for the loader"
	default 0x40000

config LOADER_NEXT_STAGE_ADDR
	hex "Address the loader jumps to"

endif
```

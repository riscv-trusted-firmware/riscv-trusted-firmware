## images/monitor/Kconfig
```kconfig
# SPDX-License-Identifier: BSD-3-Clause
# Copyright (c) 2026, The RISC-V Trusted Firmware contributors

config IMAGE_MONITOR
	bool "M-mode runtime monitor"
	default y
	help
	  The resident M-mode firmware: trap handling, drivers and services
	  (SBI and, later, the security services).

if IMAGE_MONITOR

config MONITOR_LOAD_ADDR
	hex "Monitor link/load address"
	default LOADER_NEXT_STAGE_ADDR if IMAGE_LOADER
	default PLATFORM_FW_START

config MONITOR_PIE
	bool "Position-independent monitor"
	default y
	help
	  MONITOR_LOAD_ADDR is then only where the monitor is linked for: it
	  relocates itself to wherever the previous stage put it (and tells
	  where that is in the device tree it passes on). Costs the
	  relocation table in the image.

config MONITOR_SIZE
	hex "Memory reserved for the monitor"
	default PLATFORM_FW_SIZE
	help
	  Hidden from S/U-mode with one PMP NAPOT entry: a power of two, and
	  MONITOR_LOAD_ADDR a multiple of it. What the image does not take
	  itself holds the harts' stacks and the heap, which the state kept
	  per hart and per domain comes from: the more of those the device
	  tree has, the more of this is needed, and the boot says when it is
	  not enough.

config MONITOR_NEXT_STAGE_ADDR
	hex "Next stage entry point"
	help
	  Where the boot hart enters S-mode, with a0 = hart id and a1 = the
	  device tree address the monitor was given. Loading the next stage
	  is up to the platform (the previous stage, or the simulator). When
	  the first word there is zero the monitor stays idle.

config MONITOR_FDT_ADDR
	hex "Address the device tree is moved to (0: in place)"
	default 0x0
	help
	  The monitor completes and fixes up the device tree it was given,
	  which makes it larger: the monitor's memory becomes reserved,
	  machine-level devices and unmanaged harts are disabled. In place,
	  the memory right after the tree (4 KiB) must be free; otherwise
	  name an address the next stage leaves alone until it has read it.

config DOMAINS
	bool "Domains"
	default y
	help
	  Partition the machine among several pieces of S-mode software, the
	  way the device tree says with the domain binding
	  ("riscv,domain,config" under /chosen): harts, memory regions with
	  permissions, a next stage, and the right to reset or suspend the
	  system, per domain. A hart can move between domains and back. A
	  tree without any of it gives the one root domain, which is what
	  the monitor does without this option.

endif
```

## images/sbitest/Kconfig
```kconfig
# SPDX-License-Identifier: BSD-3-Clause
# Copyright (c) 2026, The RISC-V Trusted Firmware contributors

config IMAGE_SBITEST
	bool "S-mode SBI test payload"
	depends on IMAGE_MONITOR && SBI_DBCN
	help
	  A small S-mode next stage that calls every SBI extension the
	  monitor implements, checks results, error codes and side effects
	  (interrupts, hart states, trap redirection, PMP), prints
	  "sbitest: PASS" or "sbitest: FAIL" and powers the machine off.
	  scripts/boot-test.sh looks for that line.

if IMAGE_SBITEST

config SBITEST_LOAD_ADDR
	hex "Test payload link/load address"
	default MONITOR_NEXT_STAGE_ADDR

config SBITEST_SIZE
	hex "Memory reserved for the test payload"
	default 0x100000

endif
```

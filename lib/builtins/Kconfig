## lib/builtins/Kconfig
```kconfig
# SPDX-License-Identifier: BSD-3-Clause
# Copyright (c) 2026, The RISC-V Trusted Firmware contributors

config LIB_BUILTINS
	bool "Always build the compiler runtime helpers"
	help
	  64-bit division helpers (__udivdi3 and friends) the compiler may
	  call on RV32. They are built automatically when the toolchain ships
	  no libgcc/compiler-rt for the target; enable this to build them
	  regardless.
```

## lib/libc/Kconfig
```kconfig
# SPDX-License-Identifier: BSD-3-Clause
# Copyright (c) 2026, The RISC-V Trusted Firmware contributors

config LIBC
	bool
	default y
	help
	  Freestanding C library subset (string.h, printf family).

config LIBC_PRINTF_BUF
	int "printf() line buffer size"
	default 256
```

## lib/libfdt/Kconfig
```kconfig
# SPDX-License-Identifier: BSD-3-Clause
# Copyright (c) 2026, The RISC-V Trusted Firmware contributors

config LIBFDT
	bool
	default y
	help
	  Upstream libfdt from the dtc project, unmodified. Always built:
	  drivers find their devices in the device tree.
```

## lib/utils/Kconfig
```kconfig
# SPDX-License-Identifier: BSD-3-Clause
# Copyright (c) 2026, The RISC-V Trusted Firmware contributors

config LIB_UTILS
	bool
	default y
	help
	  panic() and small helpers.
```

## platform/generic/fdt/Kconfig.plat
```kconfig
# SPDX-License-Identifier: BSD-3-Clause
# Copyright (c) 2026, The RISC-V Trusted Firmware contributors

config PLAT_GENERIC
	bool "Generic: whatever the device tree describes"
	select RISCV_ISA_M
	select RISCV_ISA_A
	select RISCV_ISA_C
	select RISCV_EXT_SSTC
	select RISCV_EXT_SSCOFPMF
	select RISCV_EXT_SMEPMP
	select RISCV_EXT_SMSTATEEN
	select SERIAL_UART8250
	select SERIAL_SIFIVE
	select SERIAL_HTIF
	select SERIAL_UARTLITE
	select SERIAL_CADENCE
	select SERIAL_LITEX
	select SERIAL_GAISLER
	select SERIAL_SHAKTI
	select SERIAL_RENESAS_SCIF
	select SERIAL_SEMIHOSTING
	select TIMER_ACLINT_MTIMER
	select IPI_ACLINT_MSWI
	select IPI_ANDES_PLICSW
	select IRQCHIP_PLIC
	select IRQCHIP_APLIC
	select IRQCHIP_IMSIC
	select GPIO_SIFIVE
	select RESET_SIFIVE_TEST
	select RESET_SYSCON
	select RESET_HTIF
	select RESET_GPIO
	select RESET_WDT
```

## platform/qemu/virt/Kconfig
```kconfig
# SPDX-License-Identifier: BSD-3-Clause
# Copyright (c) 2026, The RISC-V Trusted Firmware contributors

if PLAT_QEMU_VIRT

config PLATFORM_DIR
	default "qemu/virt"

config PLATFORM_NAME
	default "QEMU virt"

config PLATFORM_HART_COUNT
	default 8

config PLATFORM_FW_START
	default 0x80000000

config LOADER_NEXT_STAGE_ADDR
	default 0x80200000

# Where QEMU's -kernel puts an image: 2 MiB into RAM on RV64, 4 MiB on RV32.
# With the loader in front, the monitor itself sits at 2 MiB.
config MONITOR_NEXT_STAGE_ADDR
	default 0x80400000 if IMAGE_LOADER || RISCV_RV32I
	default 0x80200000

config QEMU_VIRT_RAM_SIZE
	hex "RAM size passed to QEMU (bytes)"
	default 0x8000000

# Defaults for symbols owned by drivers.
config SERIAL_UART8250_BASE
	default 0x10000000

config SERIAL_UART8250_CLOCK
	default 3686400

config SERIAL_UART8250_REG_SHIFT
	default 0

config SERIAL_UART8250_REG_WIDTH
	default 1

# CLINT at 0x2000000: MSWI, then MTIMER (mtimecmp +0x4000, mtime +0xbff8).
config IPI_ACLINT_MSWI_ADDR
	default 0x2000000

config TIMER_ACLINT_MTIMER_MTIMECMP_ADDR
	default 0x2004000

config TIMER_ACLINT_MTIMER_MTIME_ADDR
	default 0x200bff8

config RESET_SIFIVE_TEST_ADDR
	default 0x100000

config SBI_SUSP
	default y

config QEMU_VIRT_DOMAINS
	bool "Describe domains, for the SBI test payload"
	depends on DOMAINS && IMAGE_SBITEST
	help
	  Adds a domain configuration to the device tree: the test payload
	  runs in a domain without access to the memory of two others, one
	  it enters on its own harts and one that has the last hart to
	  itself. All three run parts of the test payload's image.

config QEMU_VIRT_DOMAINS_MEM
	hex "Memory for the test domains (2 MiB and a page)"
	depends on QEMU_VIRT_DOMAINS
	default 0x80a00000

config QEMU_VIRT_RPMI
	bool "Describe an RPMI transport in RAM, for a PuC model"
	default y if IMAGE_SBITEST
	select RPMI
	select RPMI_SHMEM
	select MPXY
	select RESET_RPMI
	select SUSPEND_RPMI
	select HSM_RPMI
	select CPPC_RPMI
	help
	  QEMU virt has no platform microcontroller. With this the platform
	  adds to the device tree what a platform with one would have there:
	  an RPMI shared memory transport (16 KiB of RAM), MPXY channels for
	  the clock and voltage service groups, and the RPMI users for reset,
	  suspend, hart power and CPPC. The drivers then find all of it like
	  on real hardware. The SBI test payload runs a PuC model on one hart
	  to test it end to end; with no PuC listening the RPMI users stand
	  aside (after a timeout each time they are asked).

if QEMU_VIRT_RPMI

config QEMU_VIRT_RPMI_CHANNEL_BASE
	hex "First MPXY channel id"
	default 0x1000

# Clear of everything QEMU loads with at least 128 MiB of RAM.
config QEMU_VIRT_RPMI_SHMEM_BASE
	hex "Address of the four queues"
	default 0x83f00000

config QEMU_VIRT_RPMI_QUEUE_SIZE
	hex "Size of each queue"
	default 0x1000

config QEMU_VIRT_RPMI_SLOT_SIZE
	int "Slot size"
	default 64

# The PuC model runs in S-mode.
config RPMI_SHMEM_PROTECT
	default n

endif

endif
```

## platform/qemu/virt/Kconfig.plat
```kconfig
# SPDX-License-Identifier: BSD-3-Clause
# Copyright (c) 2026, The RISC-V Trusted Firmware contributors

config PLAT_QEMU_VIRT
	bool "QEMU virt machine"
	select RISCV_ISA_M
	select RISCV_ISA_A
	select RISCV_ISA_C
	select RISCV_EXT_SSTC
	select RISCV_EXT_SSCOFPMF
	select SERIAL_UART8250
	select TIMER_ACLINT_MTIMER
	select IPI_ACLINT_MSWI
	select RESET_SIFIVE_TEST
	select RESET_SYSCON
	select IRQCHIP_PLIC
	select IRQCHIP_APLIC
	select IRQCHIP_IMSIC
	select RISCV_EXT_SMSTATEEN
```

## services/core/Kconfig
```kconfig
# SPDX-License-Identifier: BSD-3-Clause
# Copyright (c) 2026, The RISC-V Trusted Firmware contributors

config SERVICE_CORE
	bool
	default y
	help
	  Service table and ecall dispatcher (always built).
```

## services/mpxy/Kconfig
```kconfig
# SPDX-License-Identifier: BSD-3-Clause
# Copyright (c) 2026, The RISC-V Trusted Firmware contributors

config MPXY
	bool "Message proxy channels (SBI MPXY extension)"
	depends on SBI
	help
	  Lets S-mode exchange messages with a message protocol implementation
	  through the monitor: per-hart shared memory, channels with
	  attributes, messages with and without response, notification
	  events. Channels come from the message protocols below.

if MPXY

config MPXY_SSE_EVENTS
	int "Channels that can signal notification events through SSE"
	range 0 64
	default 8 if SBI_SSE
	default 0
	help
	  Each such channel gets a platform specific global software event
	  (0x0010c000 up), in the order the channels are found, which is
	  raised when the channel has notification events to fetch. S-mode
	  reads the event id from the channel's SSE_EVENT_ID attribute. An
	  MSI, which S-mode sets up through the channel attributes and which
	  takes no support from the platform, is preferred when both are on.

config MPXY_RPMI
	bool "RPMI service groups as MPXY channels"
	depends on RPMI
	default y
	help
	  One channel per RPMI service group the platform opens to S-mode
	  (system MSI, voltage, clock, device power, performance, management
	  mode, RAS agent, request forward, or a group of the platform's
	  own), forwarded to the platform microcontroller once the request
	  is a well-formed one of the group. The channels are the
	  "riscv,rpmi-mpxy-*" nodes of the device tree.

config MPXY_RPMI_FW
	bool "RPMI service groups served by the monitor"
	depends on DOMAINS
	default y
	help
	  RPMI over MPXY without a platform microcontroller behind it, for
	  what is the SBI implementation's to do: forwarding requests from
	  one domain to another. "riscv,rpmi-mpxy-request-forward" nodes
	  without "mboxes" are the REQUEST_FORWARD channels through which a
	  domain takes the requests forwarded to it and answers them;
	  "riscv,rpmi-mpxy-mm-domain" nodes are MANAGEMENT_MODE channels
	  whose MM_COMMUNICATE requests are forwarded to the domain that
	  hosts the management mode.

config MPXY_RPMI_FW_MAX_CHANNELS
	int "Maximum number of channels served by the monitor"
	depends on MPXY_RPMI_FW
	default 4

config MPXY_RPMI_MAX_CHANNELS
	int "Maximum number of RPMI channels"
	depends on MPXY_RPMI
	default 8

config MPXY_RPMI_MAX_SYSMSI
	int "Most system MSIs of a PuC"
	depends on MPXY_RPMI
	default 128
	help
	  The SYSTEM_MSI service group: the monitor keeps the MSIs that are
	  M-mode's, and the transport's P2A doorbell, away from S-mode. MSIs
	  beyond this number are out of S-mode's reach.

config MPXY_RPMI_EVENT_BUF_SIZE
	int "Notification event buffer per RPMI channel (bytes)"
	depends on MPXY_RPMI
	default 512
	help
	  Events the PuC sent and S-mode has not fetched yet. When it is
	  full, further events are counted as lost. A multiple of 4.

endif
```

## services/sbi/Kconfig
```kconfig
# SPDX-License-Identifier: BSD-3-Clause
# Copyright (c) 2026, The RISC-V Trusted Firmware contributors

menuconfig SBI
	bool "SBI (Supervisor Binary Interface)"
	default y
	help
	  RISC-V SBI implementation exposed to S-mode software. The base,
	  TIME, IPI, RFENCE, HSM and SRST extensions are always built; each
	  reports itself through the probe call only when its backend (timer,
	  IPI or reset driver) is there. Every extension is its own service.

if SBI

config SBI_IMPL_ID
	hex "SBI implementation ID"
	default 0xff
	help
	  Value returned by sbi_get_impl_id(). IDs are allocated in the SBI
	  specification; 0xff is a placeholder until one is registered.

config SBI_IMPL_VERSION
	hex "SBI implementation version"
	default 0x00000100

config SBI_SSE
	bool "Supervisor software events extension (SSE)"
	default y
	help
	  Events injected into S-mode ahead of anything S-mode can mask.
	  Sources so far: the software injected local and global events.

config SBI_DBTR
	bool "Debug triggers extension (DBTR)"
	default y
	help
	  Hardware breakpoints and watchpoints for S-mode, on harts with the
	  Sdtrig extension: address / data match triggers.

config SBI_DBTR_MAX_TRIGGERS
	int "Most triggers per hart the monitor manages"
	depends on SBI_DBTR
	range 1 64
	default 16

config SBI_SUSP
	bool "System suspend extension (SUSP)"
	help
	  Suspend to RAM as an M-mode wait for an S-mode interrupt, with all
	  other harts stopped. For platforms (and simulators) without a
	  deeper system sleep state of their own.

config SBI_PMU
	bool "Performance monitoring unit extension (PMU)"
	default y
	select LIBFDT
	help
	  Hardware counters (cycles and instructions; the programmable ones
	  as far as the "riscv,pmu" device tree node maps events to them) and
	  firmware counters for what the monitor does on S-mode's behalf.

config SBI_DBCN
	bool "Debug console extension (DBCN)"
	default y

config SBI_LEGACY
	bool "Legacy v0.1 extensions (EIDs 0x00-0x08)"
	default y
	help
	  set_timer, console putchar/getchar, clear/send IPI, remote fences
	  and shutdown as defined before SBI v0.2. Deprecated by the
	  specification; current kernels do not need them.

endif
```
